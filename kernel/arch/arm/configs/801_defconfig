## kernel/drivers/net/wireless/rtl8192cu/Kconfig
```kconfig
config RTL8192CU
	select WIRELESS_EXT
	select WEXT_PRIV
	tristate "Realtek 8192C USB WiFi"
	depends on USB
	---help---
	  Help message of RTL8192CU
```
